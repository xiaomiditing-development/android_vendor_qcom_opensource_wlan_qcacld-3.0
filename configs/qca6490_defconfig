## configs/qca6490_defconfig
```kconfig
CONFIG_CNSS_QCA6490 := y
include /home/mohmd/crDroid/vendor/qcom/opensource/wlan/qcacld-3.0/configs/default_defconfig

#Enable Constrained Application Protocol feature
CONFIG_WLAN_FEATURE_COAP := y
```
